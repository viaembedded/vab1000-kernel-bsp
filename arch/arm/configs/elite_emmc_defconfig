## arch/arm/mach-elite/Kconfig
```kconfig
if ARCH_ELITE

# comment "S3Graphics Elite options"

menu "S3 Graphics Elite System-on-Chip"

choice
	prompt "S3 Graphics Elite Processor"

config ARCH_ELITE_1000
	bool "Support S3 Graphics Elite 1000"
	select VFP
	select NEON
        select ARCH_HAS_CPUFREQ
	select LOCAL_TIMERS if SMP
	select USB_ARCH_HAS_EHCI if USB_SUPPORT
	select ARM_ERRATA_754322
	select ARM_ERRATA_764369
	help
	  Include support for the Elite 1000.

# config ARCH_ELITE_1000

endchoice

config ARM_GLOBAL_TIMER
	bool "Use ARM global timer"

# ----------------------------------------------------------

if ARCH_ELITE_1000

comment "ELITE 1000 Board Type"

config MACH_EMMC
	bool "Board using eMMC chip as main storage device"
	help
	  Select this if you are using eMMC chip.

#;ysw_debug - start
config MACH_EMMC_DT
	bool "Board using eMMC chip as main storage device with Device Tree support"
	select USE_OF
	select PROC_DEVICETREE
	help
	  Machine support for S3 Graphics elite1000 machine with device tree enabled.
	  Select this if a fdt blob is available for the ELITE1000 SoC EMMC-based board.
#;ysw_debug - end

config MACH_NAND
	bool "Board using NAND flash as main storage device"
	help
	  Select this if you are using NAND flash.

config MACH_NAND_DT
	bool "Board using device tree"
	select USE_OF
	select PROC_DEVICETREE
	help
	  Machine support for S3 Graphics elite1000 machine with device tree enabled.
	  Select this if a fdt blob is available for the ELITE1000 SoC based board.

endif
# ----------------------------------------------------------

endmenu

endif
```

## arch/arm/mach-elite2000/Kconfig
```kconfig
if ARCH_ELITE2000

# comment "S3Graphics Elite options"

menu "S3 Graphics Elite2K System-on-Chip"

choice
	prompt "S3 Graphics Elite Processor"

config ARCH_ELITE_2000
	bool "Support S3 Graphics Elite 2000"
	select VFP
	select NEON
        select ARCH_HAS_CPUFREQ
	select LOCAL_TIMERS if SMP
	select USB_ARCH_HAS_EHCI if USB_SUPPORT
	select ARM_ERRATA_754322
	select ARM_ERRATA_764369
	help
	  Include support for the Elite 2000.

# config ARCH_ELITE_2000

endchoice

config ARM_GLOBAL_TIMER
	bool "Use ARM global timer"

# ----------------------------------------------------------

if ARCH_ELITE_2000

comment "ELITE 2000 Board Type"

#config MACH_EMMC
#	bool "Board using eMMC chip as main storage device"
#	help
#	  Select this if you are using eMMC chip.

#config MACH_NAND
#	bool "Board using NAND flash as main storage device"
#	help
#	  Select this if you are using NAND flash.

config MACH_NAND_DT
	bool "Board using device tree"
	select USE_OF
	select PROC_DEVICETREE
	help
	  Machine support for S3 Graphics elite2000 machine with device tree enabled.
	  Select this if a fdt blob is available for the ELITE 2000 SoC based board.

endif
# ----------------------------------------------------------

endmenu

endif
```

## drivers/char/dtv/Kconfig
```kconfig
#
# DTV device configuration
#

menuconfig ELITE_DTV
	tristate "DTV Hardware Support"
	---help---
	  Following include dtv drivers
if ELITE_DTV
config ELITE_DEMUX0
	tristate "elite demux0 driver"
	depends on ARCH_ELITE
	default n
	---help---
	  Demux0 elite driver

config ELITE_DEMUX1
	tristate "elite demux1 driver"
	depends on ARCH_ELITE
	default n
	---help---
	  Demux1 elite driver

config ELITE_DEMUX2
	tristate "elite demux2 driver"
	depends on ARCH_ELITE
	default n
	---help---
	  Demux2 elite driver

config ELITE_DEMUX3
	tristate "elite demux3 driver"
	depends on ARCH_ELITE
	default n
	---help---
	  Demux3 elite driver

config ELITE_FRONTEND
	tristate "elite frontend driver"
	depends on ARCH_ELITE
	default n
	---help---
	   Frontend driver

config ELITE_SMARTCARD
	tristate "elite smartcard driver"
	depends on ARCH_ELITE
	default n
	---help---
	  elite smart card driver

config ELITE_FRONTPANEL
	tristate "elite frontpanel driver"
	depends on ARCH_ELITE
	default n
	---help---
	  elite frontpanel driver

config ELITE_DTV_MMAP
	tristate "elite crypto client driver for DTV"
	depends on ARCH_ELITE
	depends on CRYPTO_DEV_ELITE_CRYPTO
	default n
	---help---
	  elite frontpanel driver

config ELITE_DEMOD
	tristate "elite demod driver"
	depends on ARCH_ELITE
	default n
	---help---
	   Demod driver
endif
```

## drivers/input/rmtctl/Kconfig
```kconfig
#
# Input core configuration
#
menuconfig INPUT_RMTCTL
	bool "Remote controllers" 
	help
	  Say Y here, and a list of supported remote control devices will 
	  be displayed. This option doesn't affect the kernel.

	  If unsure, say Y.

if INPUT_RMTCTL

config RMTCTL_ELITE
	tristate "ELITE remote control support"
	default y
	depends on INPUT && INPUT_RMTCTL && ARCH_ELITE
	help
	  Say Y here if you want remote control support for S3.

	  If unsure, say Y.

	  To compile this driver as a module, choose M here: the
	  module will be called atkbd.
endif
```

## drivers/net/wireless/rtl8192cu/Kconfig
```kconfig
config RTL8192CU_WNA3100M
	tristate "Realtek 8192C USB WiFi for wna3100m offical version"
	depends on USB
	---help---
	  Help message of RTL8192CU
```

## drivers/net/wireless/sdw821/Kconfig
```kconfig
#
# SDW821 Wireless LAN device configuration
#

config SDW821
      tristate "SPECTEC sdw-821 chipset  802.11b/g support"
      depends on MMC_ELITE
      select WIRELESS_EXT
      select WEXT_PRIV
      select WEXT_SPY
      select FW_LOADER
       ---help---
        A driver 802.11b/g wireless cards based on the SPECTEC
        chips. This driver supports standard Linux wireless extensions.

        Many  cards based on this chipset do not have flash memory
        and need their firmware loaded at start-up. If yours is
        one of these, you will need to provide a firmware image
        to be loaded into the card by the driver. The SPECTEC
        firmware package can be found in drivers/net/wireless/sdw821
        directory, named ks7010sd.rom. Configuable file ks79xx.cfg also
        locate in the same directory.
```

## drivers/slimbus/Kconfig
```kconfig
#
# SLIMBUS driver configuration
#
menuconfig SLIMBUS
	bool "Slimbus support"
	depends on HAS_IOMEM
	help
	  Slimbus is standard interface between baseband and
	  application processors and peripheral components in mobile
	  terminals.

if SLIMBUS
config SLIMBUS_MSM_CTRL
	tristate "Elite Slimbus Master Component"
	help
	  Select driver for Elite2k Slimbus Master Component.

endif
```

## elite_android_defconfig
```kconfig
CONFIG_EXPERIMENTAL=y
# CONFIG_SWAP is not set
CONFIG_SYSVIPC=y
CONFIG_LOG_BUF_SHIFT=14
CONFIG_SYSFS_DEPRECATED_V2=y
CONFIG_SLAB=y
CONFIG_MODULES=y
CONFIG_MODULE_UNLOAD=y
CONFIG_HIGHMEM=y
CONFIG_GENERIC_GPIO=y
CONFIG_ARCH_ELITE=y

CONFIG_TICK_ONESHOT=y
CONFIG_NO_HZ=y
CONFIG_HIGH_RES_TIMERS=y
CONFIG_GENERIC_CLOCKEVENTS_BUILD=y

CONFIG_AEABI=y
CONFIG_OABI_COMPAT=y
CONFIG_PCI=y

CONFIG_SMP=y
CONFIG_NR_CPUS=2

CONFIG_ZBOOT_ROM_TEXT=0x0
CONFIG_ZBOOT_ROM_BSS=0x0
CONFIG_CMDLINE="root=/dev/nfs nfsroot=10.1.69.3:/work/nfsroot ip=dhcp console=ttyAMA0 mem=128M"
CONFIG_VFP=y
CONFIG_NET=y
CONFIG_NETDEVICES=y
CONFIG_NET_ETHERNET=y
CONFIG_SDW821=y
CONFIG_MII=y
CONFIG_IPV6=y
CONFIG_PACKET=y
CONFIG_UNIX=y
CONFIG_INET=y
CONFIG_IP_PNP=y
CONFIG_IP_PNP_DHCP=y
CONFIG_IP_PNP_BOOTP=y

CONFIG_SERIAL_ELITE_UART_CONSOLE=y
CONFIG_SERIAL_ELITE_UART=y

CONFIG_RTC_LIB=y
CONFIG_RTC_CLASS=y
CONFIG_RTC_HCTOSYS=y
CONFIG_RTC_DRV_ELITE=y

CONFIG_RTC_INTF_SYSFS=y
CONFIG_RTC_INTF_PROC=y
CONFIG_RTC_INTF_DEV=y
CONFIG_RTC_INTF_ALARM=y

CONFIG_DEBUG_KERNEL=y
CONFIG_DEBUG_USER=y
CONFIG_DEBUG_ERRORS=y
CONFIG_HAS_IOMEM=y

#add for mmc host
CONFIG_MMC=y
CONFIG_MMC_ELITE=y
CONFIG_MMC_BLOCK=y
CONFIG_MMC_BLOCK_BOUNCE=y
CONFIG_PROC_FS=y
CONFIG_BLOCK=y
# add for sdio device wireless
#CONFIG_WLAN =y
#CONFIG_ELITE_WIFI =y
CONFIG_SDIO_UART=y
#

CONFIG_BLK_DEV_INITRD=y
CONFIG_BLK_DEV_RAM=y
CONFIG_BLK_DEV_RAM_SIZE=8192
CONFIG_PM=y
#
# File systems
#
CONFIG_EXT2_FS=y
#
# CD-ROM/DVD Filesystems
# For ELITE SATA controller
#
CONFIG_ISO9660_FS=y
CONFIG_JOLIET=y
CONFIG_ZISOFS=y
#
# Pseudo filesystems
#
CONFIG_SYSFS=y
CONFIG_TMPFS=y
CONFIG_CRAMFS=y
CONFIG_NFS_FS=y
CONFIG_VFAT_FS=y
CONFIG_INOTIFY=y
CONFIG_NFS_V3=y
CONFIG_ROOT_NFS=y
CONFIG_RPCSEC_GSS_KRB5=y
CONFIG_NLS_CODEPAGE_437=y
CONFIG_NLS_ISO8859_1=y
CONFIG_MAGIC_SYSRQ=y

#
# SCSI & ATA support
# For ELITE SATA controller
#
CONFIG_SCSI=y
CONFIG_SCSI_DMA=y
CONFIG_SCSI_PROC_FS=y
#
# SCSI support type (disk, tape, CD-ROM)
#
CONFIG_BLK_DEV_SD=y
CONFIG_BLK_DEV_SR=y
CONFIG_BLK_DEV_SR_VENDOR=y
CONFIG_CHR_DEV_SG=y
CONFIG_SCSI_MULTI_LUN=y
CONFIG_SCSI_CONSTANTS=y
CONFIG_SCSI_SCAN_ASYNC=y
CONFIG_SCSI_WAIT_SCAN=m
#
# SCSI Transports
#
CONFIG_SCSI_LOWLEVEL=y
CONFIG_ATA=y
CONFIG_ATA_VERBOSE_ERROR=y
CONFIG_SATA_PMP=y
#
#
# Input device support
#
CONFIG_INPUT=y
CONFIG_INPUT_RMTCTL=y
CONFIG_RMTCTL_ELITE=y

# Controllers with non-SFF native interface
#
CONFIG_ELITE_VIA=n
CONFIG_ATA_SFF=y
#
# SFF controllers with custom DMA interface
#
CONFIG_ATA_BMDMA=y

CONFIG_I2C=y
CONFIG_I2C_CHARDEV=y
CONFIG_I2C_BOARDINFO=y
CONFIG_I2C_COMPAT=y
CONFIG_I2C_HELPER_AUTO=y
CONFIG_I2C_ELITE=y
CONFIG_FB=y
CONFIG_FB_CFB_FILLRECT=y
CONFIG_FB_CFB_COPYAREA=y
CONFIG_FB_CFB_IMAGEBLIT=y
CONFIG_FB_S1D13XXX=y

#
# Console display driver support
#
CONFIG_FRAMEBUFFER_CONSOLE=y
CONFIG_FONT_8x8=y
CONFIG_FONT_8x16=y


#
# Input Device
#
CONFIG_INPUT_MOUSEDEV=y
CONFIG_INPUT_MOUSEDEV_PSAUX=y
CONFIG_INPUT_EVDEV=y
CONFIG_INPUT_KEYBOARD=y
CONFIG_INPUT_MOUSE=y
CONFIG_KEYBOARD_ATKBD=y
CONFIG_KEYBOARD_XTKBD=y

#
# USB Video
#
CONFIG_V4L_USB_DRIVERS=y
CONFIG_USB_VIDEO_CLASS=y
CONFIG_USB_VIDEO_CLASS_INPUT_EVDEV=y

#
# USB Audio
#
CONFIG_SND_ARM=y
CONFIG_SND_USB=y
CONFIG_SND_USB_AUDIO=y


#
# USB Input Devices
#
CONFIG_USB_HID=y
CONFIG_HID_PID=y
CONFIG_USB_HIDDEV=y

#
# USB Host controller
#

CONFIG_USB_ARCH_HAS_EHCI=y
CONFIG_USB_SUPPORT=y
CONFIG_USB_COMMON=y
CONFIG_USB_ARCH_HAS_HCD=y
CONFIG_USB=y
CONFIG_USB_DEVICE_CLASS=y
CONFIG_USB_EHCI_HCD=y
CONFIG_EHCI_ELITE=y
CONFIG_USB_EHCI_HCD_PLATFORM=y
CONFIG_USB_UHCI_HCD=y
CONFIG_UHCI_ELITE=y
CONFIG_USB_UHCI_SUPPORT_NON_PCI_HC=y

#
# USB storage
#

CONFIG_USB_STORAGE=y
CONFIG_USB_UAS=y


CONFIG_PINCTRL=y
#
# Pin controllers
#
CONFIG_PINMUX=y
CONFIG_PINCONF=y
CONFIG_GENERIC_PINCONF=y
CONFIG_ARCH_REQUIRE_GPIOLIB=y
# CONFIG_DEBUG_PINCTRL is not set
CONFIG_PINCTRL_ELITE=y
CONFIG_GPIOLIB=y
CONFIG_GPIO_ELITE=y

CONFIG_SOUND=y
CONFIG_SND=y
CONFIG_SND_TIMER=y
CONFIG_SND_PCM=y
CONFIG_SND_JACK=y
CONFIG_SND_SUPPORT_OLD_API=y
CONFIG_SND_VERBOSE_PROCFS=y
CONFIG_SND_DRIVERS=y
CONFIG_SND_PCI=y
CONFIG_SND_SOC=y
CONFIG_SND_I2S_ELITE_SOC=y
CONFIG_SND_SOC_I2C_AND_SPI=y



#
# Android
#
CONFIG_ANDROID=y
CONFIG_ANDROID_BINDER_IPC=y
CONFIG_ASHMEM=y
CONFIG_ANDROID_LOGGER=y
CONFIG_ANDROID_PERSISTENT_RAM=y
CONFIG_ANDROID_RAM_CONSOLE=y
CONFIG_ANDROID_TIMED_OUTPUT=y
CONFIG_ANDROID_LOW_MEMORY_KILLER=y
CONFIG_ANDROID_SWITCH=y
CONFIG_ANDROID_INTF_ALARM=y
CONFIG_ANDROID_INTF_ALARM_DEV=y
CONFIG_ANDROID_ALARM_OLDDRV_COMPAT=y
# CONFIG_PHONE is not set
# CONFIG_USB_WPAN_HCD is not set
CONFIG_CLKDEV_LOOKUP=y


CONFIG_STAGING=y
CONFIG_REED_SOLOMON=y
CONFIG_REED_SOLOMON_ENC8=y
CONFIG_REED_SOLOMON_DEC8=y


CONFIG_MTD=y
CONFIG_MTD_TESTS=m
# CONFIG_MTD_REDBOOT_PARTS is not set
# CONFIG_MTD_CMDLINE_PARTS is not set
CONFIG_MTD_AFS_PARTS=y
# CONFIG_MTD_AR7_PARTS is not set

#
# User Modules And Translation Layers
#
CONFIG_MTD_CHAR=y
CONFIG_MTD_BLKDEVS=y
CONFIG_MTD_BLOCK=y
# CONFIG_FTL is not set
# CONFIG_NFTL is not set
# CONFIG_NFTL_RW=y
# CONFIG_INFTL is not set
# CONFIG_RFD_FTL is not set
# CONFIG_SSFDC is not set
# CONFIG_SM_FTL is not set
# CONFIG_MTD_OOPS is not set

#
# RAM/ROM/Flash chip drivers
#
# CONFIG_MTD_CFI is not set
# CONFIG_MTD_JEDECPROBE is not set
CONFIG_MTD_MAP_BANK_WIDTH_1=y
CONFIG_MTD_MAP_BANK_WIDTH_2=y
CONFIG_MTD_MAP_BANK_WIDTH_4=y
# CONFIG_MTD_MAP_BANK_WIDTH_8 is not set
# CONFIG_MTD_MAP_BANK_WIDTH_16 is not set
# CONFIG_MTD_MAP_BANK_WIDTH_32 is not set
CONFIG_MTD_CFI_I1=y
CONFIG_MTD_CFI_I2=y
# CONFIG_MTD_CFI_I4 is not set
# CONFIG_MTD_CFI_I8 is not set
# CONFIG_MTD_RAM is not set
# CONFIG_MTD_ROM is not set
# CONFIG_MTD_ABSENT is not set

#
# Mapping drivers for chip access
#
# CONFIG_MTD_COMPLEX_MAPPINGS is not set
# CONFIG_MTD_TS5500 is not set
# CONFIG_MTD_INTEL_VR_NOR is not set
# CONFIG_MTD_PLATRAM is not set

#
# Self-contained MTD device drivers
#
# CONFIG_MTD_PMC551 is not set
# CONFIG_MTD_SLRAM is not set
# CONFIG_MTD_PHRAM is not set
# CONFIG_MTD_MTDRAM is not set
# CONFIG_MTD_BLOCK2MTD is not set

#
# Disk-On-Chip Device Drivers
#
# CONFIG_MTD_DOC2000 is not set
# CONFIG_MTD_DOC2001 is not set
# CONFIG_MTD_DOC2001PLUS is not set
# CONFIG_MTD_DOCG3 is not set
CONFIG_MTD_NAND_ECC=y
# CONFIG_MTD_NAND_ECC_SMC is not set
CONFIG_MTD_NAND=y
# CONFIG_MTD_NAND_VERIFY_WRITE is not set
# CONFIG_MTD_NAND_ECC_BCH is not set
# CONFIG_MTD_SM_COMMON is not set
# CONFIG_MTD_NAND_MUSEUM_IDS is not set
# CONFIG_MTD_NAND_DENALI is not set
CONFIG_MTD_NAND_IDS=y
# CONFIG_MTD_NAND_RICOH is not set
# CONFIG_MTD_NAND_DISKONCHIP is not set
# CONFIG_MTD_NAND_DOCG4 is not set
# CONFIG_MTD_NAND_CAFE is not set
# CONFIG_MTD_NAND_NANDSIM is not set
# CONFIG_MTD_NAND_PLATFORM is not set
CONFIG_MTD_NAND_ELITE=y
CONFIG_MTD_NAND_CHIP_NUM=1
CONFIG_MTD_NAND_ELITE_HWECC=y
CONFIG_MTD_NAND_PAGE_SIZE=2048
CONFIG_MTD_NAND_HM_ECC=2
# CONFIG_MTD_ONENAND is not set

#
# LPDDR flash memory drivers
#
# CONFIG_MTD_LPDDR is not set
# CONFIG_MTD_UBI is not set
# CONFIG_PARPORT is not set
CONFIG_BLK_DEV=y
# CONFIG_BLK_DEV_PCIESSD_MTIP32XX is not set
# CONFIG_BLK_CPQ_DA is not set
# CONFIG_BLK_CPQ_CISS_DA is not set
# CONFIG_BLK_DEV_DAC960 is not set
# CONFIG_BLK_DEV_UMEM is not set
# CONFIG_BLK_DEV_COW_COMMON is not set
# CONFIG_BLK_DEV_LOOP is not set

CONFIG_YAFFS_FS=y
CONFIG_YAFFS_YAFFS1=y
# CONFIG_YAFFS_9BYTE_TAGS is not set
# CONFIG_YAFFS_DOES_ECC is not set
CONFIG_YAFFS_YAFFS2=y
CONFIG_YAFFS_AUTO_YAFFS2=y
CONFIG_YAFFS_DISABLE_TAGS_ECC=y
# CONFIG_YAFFS_ALWAYS_CHECK_CHUNK_ERASED is not set
# CONFIG_YAFFS_EMPTY_LOST_AND_FOUND is not set
# CONFIG_YAFFS_DISABLE_BLOCK_REFRESHING is not set
# CONFIG_YAFFS_DISABLE_BACKGROUND is not set
CONFIG_YAFFS_XATTR=y

#
# Multifunction device drivers
#
CONFIG_MFD_CORE=y

CONFIG_MFD_WM831X=y
CONFIG_MFD_WM831X_I2C=y

CONFIG_REGULATOR=y

CONFIG_REGULATOR_WM831X=y

#
# Generic Driver Options
#

CONFIG_REGMAP=y
CONFIG_REGMAP_I2C=y
```

## sound/soc/elite/Kconfig
```kconfig
config SND_I2S_ELITE_SOC
	tristate "SoC I2S Audio Support for S3 Elite Chips"
	depends on ARCH_ELITE
	help
          Say Y or M if you want to add support for codecs attached to
          the ELITE I2S interface. You will also need to select the audio
          interfaces to support below.

config SND_ELITE_WM8900
	tristate "WM8900 Codec on S3 Elite Machine(Board)"
	depends on SND_I2S_ELITE_SOC
	select SND_SOC_WM8900
        help
          Say Y or M if you want to add support for WM8900 which serves
          as an audio codec on S3 Elite-based Development Kit.

config SND_ELITE_WM8960
	tristate "WM8960 Codec on S3 Elite Machine(Board)"
	depends on SND_I2S_ELITE_SOC
	select SND_SOC_WM8960
        help
          Say Y or M if you want to add support for WM8960 which serves
          as an audio codec on S3 Elite-based Development Kit.

config SND_ELITE_CS4344
	tristate "CS4344 Codec on S3 Elite Machien(Board)"
	depends on SND_I2S_ELITE_SOC
        select SND_SOC_CS4344
        help
          Say Y or M if you want to add support for WM8900 which serves
          as an audio codec on S3 Elite-based Development Kit.
```
